## conf/layer.conf
```bitbake
# We might have a conf and classes directory, append to BBPATH
BBPATH .= ":${LAYERDIR}"

# We have a recipes directory, add to BBFILES
BBFILES += "${LAYERDIR}/recipes*/*/*.bb ${LAYERDIR}/recipes*/*/*.bbappend"

BBFILE_COLLECTIONS += "meta-iveia"
BBFILE_PATTERN_meta-iveia := "^${LAYERDIR}/"
BBFILE_PRIORITY_meta-iveia = "8"
```

## conf/machine/atlas-i-lpe.conf
```bitbake
#@TYPE: Machine
#@NAME: iVeiaAtlas machine
#@DESCRIPTION: Machine configuration for iVeia Platforms 

require conf/machine/include/omap3.inc

PREFERRED_PROVIDER_virtual/kernel = "linux-lpe"
PREFERRED_PROVIDER_virtual/bootloader = "u-boot-atlas-i-lpe"
PREFERRED_PROVIDER_u-boot = "u-boot-atlas-i-lpe"

IMAGE_FSTYPES_append = " tar.xz "

UBOOT_MACHINE = "atlas_i_lpe_config"

# Guesswork
SERIAL_CONSOLE = "115200 ttyO0"

# and sdio
MACHINE_FEATURES = "kernel26 screen apm usbgadget usbhost vfat alsa"

# the kernel image needs to be in /boot
MACHINE_ESSENTIAL_EXTRA_RDEPENDS = "kernel"

PREFERRED_PROVIDER_virtual/libgl = "mesa-gl"
# PREFERRED_PROVIDER_virtual/egl = "libgles-omap3"
# PREFERRED_PROVIDER_virtual/libgles1 = "libgles-omap3"
# PREFERRED_PROVIDER_virtual/libgles2 = "libgles-omap3"
PREFERRED_PROVIDER_virtual/mesa = "mesa-gl"
```

## conf/machine/atlas-i-z7e.conf
```bitbake
#@TYPE: Machine
#@NAME: iVeiaAtlas machine
#@DESCRIPTION: Machine configuration for iVeia Platforms 

require conf/machine/include/tune-zynq.inc

PREFERRED_PROVIDER_virtual/kernel = "linux-z7e"
PREFERRED_PROVIDER_virtual/bootloader = "u-boot-atlas-i-z7e"
PREFERRED_PROVIDER_u-boot = "u-boot-atlas-i-z7e"

UBOOT_MACHINE = "atlas_i_z7e_2ND_STAGE_config"

IMAGE_FSTYPES_append = " tar.xz "

# Guesswork
SERIAL_CONSOLE = "115200 ttyO0"

# and sdio
MACHINE_FEATURES = "kernel26 screen apm usbgadget usbhost vfat alsa"

# the kernel image needs to be in /boot
MACHINE_ESSENTIAL_EXTRA_RDEPENDS = "kernel"
```
